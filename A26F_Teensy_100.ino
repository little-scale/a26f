// A26F
// Atari 2600 Music Interface Teensy / Teensyduino Code
// by little-scale


/* Atari 2600 and Teensy Hardware Setup: 

Atari Player 1 Pin 1 ---> Teensy Port B0 (digital pin 0)
Atari Player 1 Pin 2 ---> Teensy Port B1 (digital pin 1)
Atari Player 1 Pin 3 ---> Teensy Port B2 (digital pin 2)
Atari Player 1 Pin 4 ---> Teensy Port B3 (digital pin 3)
Atari Player 1 Pin 6 ---> Teensy Port B7 (digital pin 4)
Atari Player 1 Pin 8 ---> Teensy Ground

Atari Player 2 Pin 1 ---> Teensy Port D0 (digital pin 5)
Atari Player 2 Pin 2 ---> Teensy Port D1 (digital pin 6)
Atari Player 2 Pin 3 ---> Teensy Port D2 (digital pin 7)
Atari Player 2 Pin 4 ---> Teensy Port D3 (digital pin 8)


Atari 2600 4K Cart code as hex data:
With spaces between bytes: 78 D8 A2 00 8A A8 CA 9A 48 D0 FB A9 00 85 19 85 1A 85 15 85 16 85 17 85 18 A5 0C 30 4D AD 80 02 29 E0 C9 00 F0 17 C9 20 F0 1B C9 40 F0 1F C9 60 F0 23 C9 80 F0 27 C9 A0 F0 2B 4C 6A F0 AD 80 02 85 15 4C 6A F0 AD 80 02 85 16 4C 6A F0 AD 80 02 85 17 4C 6A F0 AD 80 02 85 18 4C 6A F0 AD 80 02 85 19 4C 6A F0 AD 80 02 85 1A 4C 19 F0 FF FF FF FF FF FF FF FF FF FF FF FF FF FF FF FF FF FF FF FF FF FF FF FF FF FF FF FF FF FF FF FF FF FF FF FF FF FF FF FF FF FF FF FF FF FF FF FF FF FF FF FF FF FF FF FF FF FF FF FF FF FF FF FF FF FF FF FF FF FF FF FF FF FF FF FF FF FF FF FF FF FF FF FF FF FF FF FF FF FF FF FF FF FF FF FF FF FF FF FF FF FF FF FF FF FF FF FF FF FF FF FF FF FF FF FF FF FF FF FF FF FF FF FF FF FF FF FF FF FF FF FF FF FF FF FF FF FF FF FF FF FF FF FF FF FF FF FF FF FF FF FF FF FF FF FF FF FF FF FF FF FF FF FF FF FF FF FF FF FF FF FF FF FF FF FF FF FF FF FF FF FF FF FF FF FF FF FF FF FF FF FF FF FF FF FF FF FF FF FF FF FF FF FF FF FF FF FF FF FF FF FF FF FF FF FF FF FF FF FF FF FF FF FF FF FF FF FF FF FF FF FF FF FF FF FF FF FF FF FF FF FF FF FF FF FF FF FF FF FF FF FF FF FF FF FF FF FF FF FF FF FF FF FF FF FF FF FF FF FF FF FF FF FF FF FF FF FF FF FF FF FF FF FF FF FF FF FF FF FF FF FF FF FF FF FF FF FF FF FF FF FF FF FF FF FF FF FF FF FF FF FF FF FF FF FF FF FF FF FF FF FF FF FF FF FF FF FF FF FF FF FF FF FF FF FF FF FF FF FF FF FF FF FF FF FF FF FF FF FF FF FF FF FF FF FF FF FF FF FF FF FF FF FF FF FF FF FF FF FF FF FF FF FF FF FF FF FF FF FF FF FF FF FF FF FF FF FF FF FF FF FF FF FF FF FF FF FF FF FF FF FF FF FF FF FF FF FF FF FF FF FF FF FF FF FF FF FF FF FF FF FF FF FF FF FF FF FF FF FF FF FF FF FF FF FF FF FF FF FF FF FF FF FF FF FF FF FF FF FF FF FF FF FF FF FF FF FF FF FF FF FF FF FF FF FF FF FF FF FF FF FF FF FF FF FF FF FF FF FF FF FF FF FF FF FF FF FF FF FF FF FF FF FF FF FF FF FF FF FF FF FF FF FF FF FF FF FF FF FF FF FF FF FF FF FF FF FF FF FF FF FF FF FF FF FF FF FF FF FF FF FF FF FF FF FF FF FF FF FF FF FF FF FF FF FF FF FF FF FF FF FF FF FF FF FF FF FF FF FF FF FF FF FF FF FF FF FF FF FF FF FF FF FF FF FF FF FF FF FF FF FF FF FF FF FF FF FF FF FF FF FF FF FF FF FF FF FF FF FF FF FF FF FF FF FF FF FF FF FF FF FF FF FF FF FF FF FF FF FF FF FF FF FF FF FF FF FF FF FF FF FF FF FF FF FF FF FF FF FF FF FF FF FF FF FF FF FF FF FF FF FF FF FF FF FF FF FF FF FF FF FF FF FF FF FF FF FF FF FF FF FF FF FF FF FF FF FF FF FF FF FF FF FF FF FF FF FF FF FF FF FF FF FF FF FF FF FF FF FF FF FF FF FF FF FF FF FF FF FF FF FF FF FF FF FF FF FF FF FF FF FF FF FF FF FF FF FF FF FF FF FF FF FF FF FF FF FF FF FF FF FF FF FF FF FF FF FF FF FF FF FF FF FF FF FF FF FF FF FF FF FF FF FF FF FF FF FF FF FF FF FF FF FF FF FF FF FF FF FF FF FF FF FF FF FF FF FF FF FF FF FF FF FF FF FF FF FF FF FF FF FF FF FF FF FF FF FF FF FF FF FF FF FF FF FF FF FF FF FF FF FF FF FF FF FF FF FF FF FF FF FF FF FF FF FF FF FF FF FF FF FF FF FF FF FF FF FF FF FF FF FF FF FF FF FF FF FF FF FF FF FF FF FF FF FF FF FF FF FF FF FF FF FF FF FF FF FF FF FF FF FF FF FF FF FF FF FF FF FF FF FF FF FF FF FF FF FF FF FF FF FF FF FF FF FF FF FF FF FF FF FF FF FF FF FF FF FF FF FF FF FF FF FF FF FF FF FF FF FF FF FF FF FF FF FF FF FF FF FF FF FF FF FF FF FF FF FF FF FF FF FF FF FF FF FF FF FF FF FF FF FF FF FF FF FF FF FF FF FF FF FF FF FF FF FF FF FF FF FF FF FF FF FF FF FF FF FF FF FF FF FF FF FF FF FF FF FF FF FF FF FF FF FF FF FF FF FF FF FF FF FF FF FF FF FF FF FF FF FF FF FF FF FF FF FF FF FF FF FF FF FF FF FF FF FF FF FF FF FF FF FF FF FF FF FF FF FF FF FF FF FF FF FF FF FF FF FF FF FF FF FF FF FF FF FF FF FF FF FF FF FF FF FF FF FF FF FF FF FF FF FF FF FF FF FF FF FF FF FF FF FF FF FF FF FF FF FF FF FF FF FF FF FF FF FF FF FF FF FF FF FF FF FF FF FF FF FF FF FF FF FF FF FF FF FF FF FF FF FF FF FF FF FF FF FF FF FF FF FF FF FF FF FF FF FF FF FF FF FF FF FF FF FF FF FF FF FF FF FF FF FF FF FF FF FF FF FF FF FF FF FF FF FF FF FF FF FF FF FF FF FF FF FF FF FF FF FF FF FF FF FF FF FF FF FF FF FF FF FF FF FF FF FF FF FF FF FF FF FF FF FF FF FF FF FF FF FF FF FF FF FF FF FF FF FF FF FF FF FF FF FF FF FF FF FF FF FF FF FF FF FF FF FF FF FF FF FF FF FF FF FF FF FF FF FF FF FF FF FF FF FF FF FF FF FF FF FF FF FF FF FF FF FF FF FF FF FF FF FF FF FF FF FF FF FF FF FF FF FF FF FF FF FF FF FF FF FF FF FF FF FF FF FF FF FF FF FF FF FF FF FF FF FF FF FF FF FF FF FF FF FF FF FF FF FF FF FF FF FF FF FF FF FF FF FF FF FF FF FF FF FF FF FF FF FF FF FF FF FF FF FF FF FF FF FF FF FF FF FF FF FF FF FF FF FF FF FF FF FF FF FF FF FF FF FF FF FF FF FF FF FF FF FF FF FF FF FF FF FF FF FF FF FF FF FF FF FF FF FF FF FF FF FF FF FF FF FF FF FF FF FF FF FF FF FF FF FF FF FF FF FF FF FF FF FF FF FF FF FF FF FF FF FF FF FF FF FF FF FF FF FF FF FF FF FF FF FF FF FF FF FF FF FF FF FF FF FF FF FF FF FF FF FF FF FF FF FF FF FF FF FF FF FF FF FF FF FF FF FF FF FF FF FF FF FF FF FF FF FF FF FF FF FF FF FF FF FF FF FF FF FF FF FF FF FF FF FF FF FF FF FF FF FF FF FF FF FF FF FF FF FF FF FF FF FF FF FF FF FF FF FF FF FF FF FF FF FF FF FF FF FF FF FF FF FF FF FF FF FF FF FF FF FF FF FF FF FF FF FF FF FF FF FF FF FF FF FF FF FF FF FF FF FF FF FF FF FF FF FF FF FF FF FF FF FF FF FF FF FF FF FF FF FF FF FF FF FF FF FF FF FF FF FF FF FF FF FF FF FF FF FF FF FF FF FF FF FF FF FF FF FF FF FF FF FF FF FF FF FF FF FF FF FF FF FF FF FF FF FF FF FF FF FF FF FF FF FF FF FF FF FF FF FF FF FF FF FF FF FF FF FF FF FF FF FF FF FF FF FF FF FF FF FF FF FF FF FF FF FF FF FF FF FF FF FF FF FF FF FF FF FF FF FF FF FF FF FF FF FF FF FF FF FF FF FF FF FF FF FF FF FF FF FF FF FF FF FF FF FF FF FF FF FF FF FF FF FF FF FF FF FF FF FF FF FF FF FF FF FF FF FF FF FF FF FF FF FF FF FF FF FF FF FF FF FF FF FF FF FF FF FF FF FF FF FF FF FF FF FF FF FF FF FF FF FF FF FF FF FF FF FF FF FF FF FF FF FF FF FF FF FF FF FF FF FF FF FF FF FF FF FF FF FF FF FF FF FF FF FF FF FF FF FF FF FF FF FF FF FF FF FF FF FF FF FF FF FF FF FF FF FF FF FF FF FF FF FF FF FF FF FF FF FF FF FF FF FF FF FF FF FF FF FF FF FF FF FF FF FF FF FF FF FF FF FF FF FF FF FF FF FF FF FF FF FF FF FF FF FF FF FF FF FF FF FF FF FF FF FF FF FF FF FF FF FF FF FF FF FF FF FF FF FF FF FF FF FF FF FF FF FF FF FF FF FF FF FF FF FF FF FF FF FF FF FF FF FF FF FF FF FF FF FF FF FF FF FF FF FF FF FF FF FF FF FF FF FF FF FF FF FF FF FF FF FF FF FF FF FF FF FF FF FF FF FF FF FF FF FF FF FF FF FF FF FF FF FF FF FF FF FF FF FF FF FF FF FF FF FF FF FF FF FF FF FF FF FF FF FF FF FF FF FF FF FF FF FF FF FF FF FF FF FF FF FF FF FF FF FF FF FF FF FF FF FF FF FF FF FF FF FF FF FF FF FF FF FF FF FF FF FF FF FF FF FF FF FF FF FF FF FF FF FF FF FF FF FF FF FF FF FF FF FF FF FF FF FF FF FF FF FF FF FF FF FF FF FF FF FF FF FF FF FF FF FF FF FF FF FF FF FF FF FF FF FF FF FF FF FF FF FF FF FF FF FF FF FF FF FF FF FF FF FF FF FF FF FF FF FF FF FF FF FF FF FF FF FF FF FF FF FF FF FF FF FF FF FF FF FF FF FF FF FF FF FF FF FF FF FF FF FF FF FF FF FF FF FF FF FF FF FF FF FF FF FF FF FF FF FF FF FF FF FF FF FF FF FF FF FF FF FF FF FF FF FF FF FF FF FF FF FF FF FF FF FF FF FF FF FF FF FF FF FF FF FF FF FF FF FF FF FF FF FF FF FF FF FF FF FF FF FF FF FF FF FF FF FF FF FF FF FF FF FF FF FF FF FF FF FF FF FF FF FF FF FF FF FF FF FF FF FF FF FF FF FF FF FF FF FF FF FF FF FF FF FF FF FF FF FF FF FF FF FF FF FF FF FF FF FF FF FF FF FF FF FF FF FF FF FF FF FF FF FF FF FF FF FF FF FF FF FF FF FF FF FF FF FF FF FF FF FF FF FF FF FF FF FF FF FF FF FF FF FF FF FF FF FF FF FF FF FF FF FF FF FF FF FF FF FF FF FF FF FF FF FF FF FF FF FF FF FF FF FF FF FF FF FF FF FF FF FF FF FF FF FF FF FF FF FF FF FF FF FF FF FF FF FF FF FF FF FF FF FF FF FF FF FF FF FF FF FF FF FF FF FF FF FF FF FF FF FF FF FF FF FF FF FF FF FF FF FF FF FF FF FF FF FF FF FF FF FF FF FF FF FF FF FF FF FF FF FF FF FF FF FF FF FF FF FF FF FF FF FF FF FF FF FF FF FF FF FF FF FF FF FF FF FF FF FF FF FF FF FF FF FF FF FF FF FF FF FF FF FF FF FF FF FF FF FF FF FF FF FF FF FF FF FF FF FF FF FF FF FF FF FF FF FF FF FF FF FF FF FF FF FF FF FF FF FF FF FF FF FF FF FF FF FF FF FF FF FF FF FF FF FF FF FF FF FF FF FF FF FF FF FF FF FF FF FF FF FF FF FF FF FF FF FF FF FF FF FF FF FF FF FF FF FF FF FF FF FF FF FF FF FF FF FF FF FF FF FF FF FF FF FF FF FF FF FF FF FF FF FF FF FF FF FF FF FF FF FF FF FF FF FF FF FF FF FF FF FF FF FF FF FF FF FF FF FF FF FF FF FF FF FF FF FF FF FF FF FF FF FF FF FF FF FF FF FF FF FF FF FF FF FF FF FF FF FF FF FF FF FF FF FF FF FF FF FF FF FF FF FF FF FF FF FF FF FF FF FF FF FF FF FF FF FF FF FF FF FF FF FF FF FF FF FF FF FF FF FF FF FF FF FF FF FF FF FF FF FF FF FF FF FF FF FF FF FF FF FF FF FF FF FF FF FF FF FF FF FF FF FF FF FF FF FF FF FF FF FF FF FF FF FF FF FF FF FF FF FF FF FF FF FF FF FF FF FF FF FF FF FF FF FF FF FF FF FF FF FF FF FF FF FF FF FF FF FF FF FF FF FF FF FF FF FF FF FF FF FF FF FF FF FF FF FF FF FF FF FF FF FF FF FF FF FF FF FF FF FF FF FF FF FF FF FF FF FF FF FF FF FF FF FF FF FF FF FF FF FF FF FF FF FF FF FF FF FF FF FF FF FF FF FF FF FF FF FF FF FF FF FF FF FF FF FF FF FF FF FF FF FF FF FF FF FF FF FF FF FF FF FF FF FF FF FF FF FF FF FF FF FF FF FF FF FF FF FF FF FF FF FF FF FF FF FF FF FF FF FF FF FF FF FF FF FF FF FF FF FF FF FF FF FF FF FF FF FF FF FF FF FF FF FF FF FF FF FF FF FF FF FF FF FF FF FF FF FF FF FF FF FF FF FF FF FF FF FF FF FF FF FF FF FF FF FF FF FF FF FF FF FF FF FF FF FF FF FF FF FF FF FF FF FF FF FF FF FF FF FF FF FF FF FF FF FF FF FF FF FF FF FF FF FF FF FF FF FF FF FF FF FF FF FF FF FF FF FF FF FF FF FF FF FF FF FF FF FF FF FF FF FF FF FF FF FF FF FF FF FF FF FF FF FF FF FF FF FF FF FF FF FF FF FF FF FF FF FF FF FF FF FF FF FF FF FF FF FF FF FF FF FF FF FF FF FF FF FF FF FF FF FF FF FF FF FF FF FF FF FF FF FF FF FF FF FF FF FF FF FF FF FF FF FF FF FF FF FF FF FF FF FF FF FF FF FF FF FF FF FF FF FF FF FF FF FF FF FF FF FF FF FF FF FF FF FF FF FF FF FF FF FF FF FF FF FF FF FF FF FF FF FF FF FF FF FF FF FF FF FF FF FF FF FF FF FF FF FF FF FF FF FF FF FF FF FF FF FF FF FF FF FF FF FF FF FF FF FF FF FF FF FF FF FF FF FF FF FF FF FF FF FF FF FF FF FF FF FF FF FF FF FF FF FF FF FF FF FF FF FF FF FF FF FF FF FF FF FF FF FF FF FF FF FF FF FF FF FF FF FF FF FF FF FF FF FF FF FF FF FF FF FF FF FF FF FF FF FF FF FF FF FF FF FF FF FF FF FF FF FF FF FF FF FF FF FF FF FF FF FF FF FF FF FF FF FF FF FF FF FF FF FF FF FF FF FF FF FF FF FF FF FF FF FF FF FF FF FF FF FF FF FF FF FF FF FF FF FF FF FF FF FF FF FF FF FF FF FF FF FF FF FF FF FF FF FF FF FF FF FF FF FF FF FF FF FF FF FF FF FF FF FF FF FF FF FF FF FF FF FF FF FF FF FF FF FF FF FF FF FF FF FF FF FF FF FF FF FF FF FF FF FF FF FF FF FF FF FF FF FF FF FF FF FF FF FF FF FF FF FF FF FF FF FF FF FF FF FF FF FF FF FF FF FF FF FF FF FF FF FF FF FF FF FF FF FF FF FF FF FF FF FF FF FF FF FF FF FF FF FF FF FF FF FF FF FF FF FF FF FF FF FF FF FF FF FF FF FF FF FF FF FF FF FF FF FF FF FF FF FF FF FF FF FF FF FF FF FF FF FF FF FF FF FF FF FF FF FF FF FF FF FF FF FF FF FF FF FF FF FF FF FF FF FF FF FF FF FF FF FF FF FF FF FF FF FF FF FF FF FF FF FF FF FF FF FF FF FF FF FF FF FF FF FF FF FF FF FF FF FF FF FF FF FF FF FF FF FF FF FF FF FF FF FF FF FF FF FF FF FF FF FF FF FF FF FF FF FF FF FF FF FF FF FF FF FF FF FF FF FF FF FF FF FF FF FF FF FF FF FF FF FF FF FF FF FF FF FF FF FF FF FF FF FF FF FF FF FF FF FF FF FF FF FF FF FF FF FF FF FF FF FF FF FF FF FF FF FF FF FF FF FF FF FF FF FF FF FF FF FF FF FF FF FF FF FF FF FF FF FF FF FF FF FF FF FF FF FF FF FF FF FF FF FF FF FF FF FF FF FF FF FF FF FF FF FF FF FF FF FF FF FF FF FF FF FF FF FF FF FF FF FF FF FF FF FF FF FF FF FF FF FF FF FF FF FF FF FF FF FF FF FF FF FF FF FF FF FF FF FF FF FF FF FF FF FF FF FF FF FF FF FF FF FF FF FF FF FF FF FF FF FF FF FF FF FF FF FF FF FF FF FF FF FF FF FF FF FF FF FF FF FF FF FF FF FF FF FF FF FF FF FF FF FF FF FF FF FF FF FF FF FF FF FF FF FF FF FF FF FF FF FF FF FF FF FF FF FF FF FF FF FF FF FF FF FF FF FF FF FF FF FF FF FF FF FF FF FF FF FF FF FF FF FF FF FF FF FF FF FF FF FF FF FF FF FF FF FF FF FF FF FF FF FF FF FF FF FF FF FF FF FF FF FF FF FF FF FF FF FF FF FF FF FF FF FF FF FF FF FF FF FF FF FF FF FF FF FF FF FF FF FF FF FF FF FF FF FF FF FF FF FF FF FF FF FF FF FF FF FF FF FF FF FF FF FF FF FF FF FF FF FF FF FF FF FF FF FF FF FF FF FF FF FF FF FF FF FF FF FF FF FF FF FF FF FF FF FF FF FF FF FF FF FF FF FF FF FF FF FF FF FF FF FF FF FF FF FF FF FF FF FF FF FF FF FF FF FF FF FF FF FF FF FF FF FF FF FF FF FF FF FF FF FF FF FF FF FF FF FF FF FF FF FF FF FF FF FF FF FF FF FF FF FF FF FF FF FF FF FF FF 00 F0 00 F0
Without spaces between bytes: 78D8A2008AA8CA9A48D0FBA9008519851A8515851685178518A50C304DAD800229E0C900F017C920F01BC940F01FC960F023C980F027C9A0F02B4C6AF0AD800285154C6AF0AD800285164C6AF0AD800285174C6AF0AD800285184C6AF0AD800285194C6AF0AD8002851A4C19F0FFFFFFFFFFFFFFFFFFFFFFFFFFFFFFFFFFFFFFFFFFFFFFFFFFFFFFFFFFFFFFFFFFFFFFFFFFFFFFFFFFFFFFFFFFFFFFFFFFFFFFFFFFFFFFFFFFFFFFFFFFFFFFFFFFFFFFFFFFFFFFFFFFFFFFFFFFFFFFFFFFFFFFFFFFFFFFFFFFFFFFFFFFFFFFFFFFFFFFFFFFFFFFFFFFFFFFFFFFFFFFFFFFFFFFFFFFFFFFFFFFFFFFFFFFFFFFFFFFFFFFFFFFFFFFFFFFFFFFFFFFFFFFFFFFFFFFFFFFFFFFFFFFFFFFFFFFFFFFFFFFFFFFFFFFFFFFFFFFFFFFFFFFFFFFFFFFFFFFFFFFFFFFFFFFFFFFFFFFFFFFFFFFFFFFFFFFFFFFFFFFFFFFFFFFFFFFFFFFFFFFFFFFFFFFFFFFFFFFFFFFFFFFFFFFFFFFFFFFFFFFFFFFFFFFFFFFFFFFFFFFFFFFFFFFFFFFFFFFFFFFFFFFFFFFFFFFFFFFFFFFFFFFFFFFFFFFFFFFFFFFFFFFFFFFFFFFFFFFFFFFFFFFFFFFFFFFFFFFFFFFFFFFFFFFFFFFFFFFFFFFFFFFFFFFFFFFFFFFFFFFFFFFFFFFFFFFFFFFFFFFFFFFFFFFFFFFFFFFFFFFFFFFFFFFFFFFFFFFFFFFFFFFFFFFFFFFFFFFFFFFFFFFFFFFFFFFFFFFFFFFFFFFFFFFFFFFFFFFFFFFFFFFFFFFFFFFFFFFFFFFFFFFFFFFFFFFFFFFFFFFFFFFFFFFFFFFFFFFFFFFFFFFFFFFFFFFFFFFFFFFFFFFFFFFFFFFFFFFFFFFFFFFFFFFFFFFFFFFFFFFFFFFFFFFFFFFFFFFFFFFFFFFFFFFFFFFFFFFFFFFFFFFFFFFFFFFFFFFFFFFFFFFFFFFFFFFFFFFFFFFFFFFFFFFFFFFFFFFFFFFFFFFFFFFFFFFFFFFFFFFFFFFFFFFFFFFFFFFFFFFFFFFFFFFFFFFFFFFFFFFFFFFFFFFFFFFFFFFFFFFFFFFFFFFFFFFFFFFFFFFFFFFFFFFFFFFFFFFFFFFFFFFFFFFFFFFFFFFFFFFFFFFFFFFFFFFFFFFFFFFFFFFFFFFFFFFFFFFFFFFFFFFFFFFFFFFFFFFFFFFFFFFFFFFFFFFFFFFFFFFFFFFFFFFFFFFFFFFFFFFFFFFFFFFFFFFFFFFFFFFFFFFFFFFFFFFFFFFFFFFFFFFFFFFFFFFFFFFFFFFFFFFFFFFFFFFFFFFFFFFFFFFFFFFFFFFFFFFFFFFFFFFFFFFFFFFFFFFFFFFFFFFFFFFFFFFFFFFFFFFFFFFFFFFFFFFFFFFFFFFFFFFFFFFFFFFFFFFFFFFFFFFFFFFFFFFFFFFFFFFFFFFFFFFFFFFFFFFFFFFFFFFFFFFFFFFFFFFFFFFFFFFFFFFFFFFFFFFFFFFFFFFFFFFFFFFFFFFFFFFFFFFFFFFFFFFFFFFFFFFFFFFFFFFFFFFFFFFFFFFFFFFFFFFFFFFFFFFFFFFFFFFFFFFFFFFFFFFFFFFFFFFFFFFFFFFFFFFFFFFFFFFFFFFFFFFFFFFFFFFFFFFFFFFFFFFFFFFFFFFFFFFFFFFFFFFFFFFFFFFFFFFFFFFFFFFFFFFFFFFFFFFFFFFFFFFFFFFFFFFFFFFFFFFFFFFFFFFFFFFFFFFFFFFFFFFFFFFFFFFFFFFFFFFFFFFFFFFFFFFFFFFFFFFFFFFFFFFFFFFFFFFFFFFFFFFFFFFFFFFFFFFFFFFFFFFFFFFFFFFFFFFFFFFFFFFFFFFFFFFFFFFFFFFFFFFFFFFFFFFFFFFFFFFFFFFFFFFFFFFFFFFFFFFFFFFFFFFFFFFFFFFFFFFFFFFFFFFFFFFFFFFFFFFFFFFFFFFFFFFFFFFFFFFFFFFFFFFFFFFFFFFFFFFFFFFFFFFFFFFFFFFFFFFFFFFFFFFFFFFFFFFFFFFFFFFFFFFFFFFFFFFFFFFFFFFFFFFFFFFFFFFFFFFFFFFFFFFFFFFFFFFFFFFFFFFFFFFFFFFFFFFFFFFFFFFFFFFFFFFFFFFFFFFFFFFFFFFFFFFFFFFFFFFFFFFFFFFFFFFFFFFFFFFFFFFFFFFFFFFFFFFFFFFFFFFFFFFFFFFFFFFFFFFFFFFFFFFFFFFFFFFFFFFFFFFFFFFFFFFFFFFFFFFFFFFFFFFFFFFFFFFFFFFFFFFFFFFFFFFFFFFFFFFFFFFFFFFFFFFFFFFFFFFFFFFFFFFFFFFFFFFFFFFFFFFFFFFFFFFFFFFFFFFFFFFFFFFFFFFFFFFFFFFFFFFFFFFFFFFFFFFFFFFFFFFFFFFFFFFFFFFFFFFFFFFFFFFFFFFFFFFFFFFFFFFFFFFFFFFFFFFFFFFFFFFFFFFFFFFFFFFFFFFFFFFFFFFFFFFFFFFFFFFFFFFFFFFFFFFFFFFFFFFFFFFFFFFFFFFFFFFFFFFFFFFFFFFFFFFFFFFFFFFFFFFFFFFFFFFFFFFFFFFFFFFFFFFFFFFFFFFFFFFFFFFFFFFFFFFFFFFFFFFFFFFFFFFFFFFFFFFFFFFFFFFFFFFFFFFFFFFFFFFFFFFFFFFFFFFFFFFFFFFFFFFFFFFFFFFFFFFFFFFFFFFFFFFFFFFFFFFFFFFFFFFFFFFFFFFFFFFFFFFFFFFFFFFFFFFFFFFFFFFFFFFFFFFFFFFFFFFFFFFFFFFFFFFFFFFFFFFFFFFFFFFFFFFFFFFFFFFFFFFFFFFFFFFFFFFFFFFFFFFFFFFFFFFFFFFFFFFFFFFFFFFFFFFFFFFFFFFFFFFFFFFFFFFFFFFFFFFFFFFFFFFFFFFFFFFFFFFFFFFFFFFFFFFFFFFFFFFFFFFFFFFFFFFFFFFFFFFFFFFFFFFFFFFFFFFFFFFFFFFFFFFFFFFFFFFFFFFFFFFFFFFFFFFFFFFFFFFFFFFFFFFFFFFFFFFFFFFFFFFFFFFFFFFFFFFFFFFFFFFFFFFFFFFFFFFFFFFFFFFFFFFFFFFFFFFFFFFFFFFFFFFFFFFFFFFFFFFFFFFFFFFFFFFFFFFFFFFFFFFFFFFFFFFFFFFFFFFFFFFFFFFFFFFFFFFFFFFFFFFFFFFFFFFFFFFFFFFFFFFFFFFFFFFFFFFFFFFFFFFFFFFFFFFFFFFFFFFFFFFFFFFFFFFFFFFFFFFFFFFFFFFFFFFFFFFFFFFFFFFFFFFFFFFFFFFFFFFFFFFFFFFFFFFFFFFFFFFFFFFFFFFFFFFFFFFFFFFFFFFFFFFFFFFFFFFFFFFFFFFFFFFFFFFFFFFFFFFFFFFFFFFFFFFFFFFFFFFFFFFFFFFFFFFFFFFFFFFFFFFFFFFFFFFFFFFFFFFFFFFFFFFFFFFFFFFFFFFFFFFFFFFFFFFFFFFFFFFFFFFFFFFFFFFFFFFFFFFFFFFFFFFFFFFFFFFFFFFFFFFFFFFFFFFFFFFFFFFFFFFFFFFFFFFFFFFFFFFFFFFFFFFFFFFFFFFFFFFFFFFFFFFFFFFFFFFFFFFFFFFFFFFFFFFFFFFFFFFFFFFFFFFFFFFFFFFFFFFFFFFFFFFFFFFFFFFFFFFFFFFFFFFFFFFFFFFFFFFFFFFFFFFFFFFFFFFFFFFFFFFFFFFFFFFFFFFFFFFFFFFFFFFFFFFFFFFFFFFFFFFFFFFFFFFFFFFFFFFFFFFFFFFFFFFFFFFFFFFFFFFFFFFFFFFFFFFFFFFFFFFFFFFFFFFFFFFFFFFFFFFFFFFFFFFFFFFFFFFFFFFFFFFFFFFFFFFFFFFFFFFFFFFFFFFFFFFFFFFFFFFFFFFFFFFFFFFFFFFFFFFFFFFFFFFFFFFFFFFFFFFFFFFFFFFFFFFFFFFFFFFFFFFFFFFFFFFFFFFFFFFFFFFFFFFFFFFFFFFFFFFFFFFFFFFFFFFFFFFFFFFFFFFFFFFFFFFFFFFFFFFFFFFFFFFFFFFFFFFFFFFFFFFFFFFFFFFFFFFFFFFFFFFFFFFFFFFFFFFFFFFFFFFFFFFFFFFFFFFFFFFFFFFFFFFFFFFFFFFFFFFFFFFFFFFFFFFFFFFFFFFFFFFFFFFFFFFFFFFFFFFFFFFFFFFFFFFFFFFFFFFFFFFFFFFFFFFFFFFFFFFFFFFFFFFFFFFFFFFFFFFFFFFFFFFFFFFFFFFFFFFFFFFFFFFFFFFFFFFFFFFFFFFFFFFFFFFFFFFFFFFFFFFFFFFFFFFFFFFFFFFFFFFFFFFFFFFFFFFFFFFFFFFFFFFFFFFFFFFFFFFFFFFFFFFFFFFFFFFFFFFFFFFFFFFFFFFFFFFFFFFFFFFFFFFFFFFFFFFFFFFFFFFFFFFFFFFFFFFFFFFFFFFFFFFFFFFFFFFFFFFFFFFFFFFFFFFFFFFFFFFFFFFFFFFFFFFFFFFFFFFFFFFFFFFFFFFFFFFFFFFFFFFFFFFFFFFFFFFFFFFFFFFFFFFFFFFFFFFFFFFFFFFFFFFFFFFFFFFFFFFFFFFFFFFFFFFFFFFFFFFFFFFFFFFFFFFFFFFFFFFFFFFFFFFFFFFFFFFFFFFFFFFFFFFFFFFFFFFFFFFFFFFFFFFFFFFFFFFFFFFFFFFFFFFFFFFFFFFFFFFFFFFFFFFFFFFFFFFFFFFFFFFFFFFFFFFFFFFFFFFFFFFFFFFFFFFFFFFFFFFFFFFFFFFFFFFFFFFFFFFFFFFFFFFFFFFFFFFFFFFFFFFFFFFFFFFFFFFFFFFFFFFFFFFFFFFFFFFFFFFFFFFFFFFFFFFFFFFFFFFFFFFFFFFFFFFFFFFFFFFFFFFFFFFFFFFFFFFFFFFFFFFFFFFFFFFFFFFFFFFFFFFFFFFFFFFFFFFFFFFFFFFFFFFFFFFFFFFFFFFFFFFFFFFFFFFFFFFFFFFFFFFFFFFFFFFFFFFFFFFFFFFFFFFFFFFFFFFFFFFFFFFFFFFFFFFFFFFFFFFFFFFFFFFFFFFFFFFFFFFFFFFFFFFFFFFFFFFFFFFFFFFFFFFFFFFFFFFFFFFFFFFFFFFFFFFFFFFFFFFFFFFFFFFFFFFFFFFFFFFFFFFFFFFFFFFFFFFFFFFFFFFFFFFFFFFFFFFFFFFFFFFFFFFFFFFFFFFFFFFFFFFFFFFFFFFFFFFFFFFFFFFFFFFFFFFFFFFFFFFFFFFFFFFFFFFFFFFFFFFFFFFFFFFFFFFFFFFFFFFFFFFFFFFFFFFFFFFFFFFFFFFFFFFFFFFFFFFFFFFFFFFFFFFFFFFFFFFFFFFFFFFFFFFFFFFFFFFFFFFFFFFFFFFFFFFFFFFFFFFFFFFFFFFFFFFFFFFFFFFFFFFFFFFFFFFFFFFFFFFFFFFFFFFFFFFFFFFFFFFFFFFFFFFFFFFFFFFFFFFFFFFFFFFFFFFFFFFFFFFFFFFFFFFFFFFFFFFFFFFFFFFFFFFFFFFFFFFFFFFFFFFFFFFFFFFFFFFFFFFFFFFFFFFFFFFFFFFFFFFFFFFFFFFFFFFFFFFFFFFFFFFFFFFFFFFFFFFFFFFFFFFFFFFFFFFFFFFFFFFFFFFFFFFFFFFFFFFFFFFFFFFFFFFFFFFFFFFFFFFFFFFFFFFFFFFFFFFFFFFFFFFFFFFFFFFFFFFFFFFFFFFFFFFFFFFFFFFFFFFFFFFFFFFFFFFFFFFFFFFFFFFFFFFFFFFFFFFFFFFFFFFFFFFFFFFFFFFFFFFFFFFFFFFFFFFFFFFFFFFFFFFFFFFFFFFFFFFFFFFFFFFFFFFFFFFFFFFFFFFFFFFFFFFFFFFFFFFFFFFFFFFFFFFFFFFFFFFFFFFFFFFFFFFFFFFFFFFFFFFFFFFFFFFFFFFFFFFFFFFFFFFFFFFFFFFFFFFFFFFFFFFFFFFFFFFFFFFFFFFFFFFFFFFFFFFFFFFFFFFFFFFFFFFFFFFFFFFFFFFFFFFFFFFFFFFFFFFFFFFFFFFFFFFFFFFFFFFFFFFFFFFFFFFFFFFFFFFFFFFFFFFFFFFFFFFFFFFFFFFFFFFFFFFFFFFFFFFFFFFFFFFFFFFFFFFFFFFFFFFFFFFFFFFFFFFFFFFFFFFFFFFFFFFFFFFFFFFFFFFFFFFFFFFFFFFFFFFFFFFFFFFFFFFFFFFFFFFFFFFFFFFFFFFFFFFFFFFFFFFFFFFFFFFFFFFFFFFFFFFFFFFFFFFFFFFFFFFFFFFFFFFFFFFFFFFFFFFFFFFFFFFFFFFFFFFFFFFFFFFFFFFFFFFFFFFFFFFFFFFFFFFFFFFFFFFFFFFFFFFFFFFFFFFFFFFFFFFFFFFFFFFFFFFFFFFFFFFFFFFFFFFFFFFFFFFFFFFFFFFFFFFFFFFFFFFFFFFFFFFFFFFFFFFFFFFFFFFFFFFFFFFFFFFFFFFFFFFFFFFFFFFFFFFFFFFFFFFFFFFFFFFFFFFFFFFFFFFFFFFFFFFFFFFFFFFFFFFFFFFFFFFFFFFFFFFFFFFFFFFFFFFFFFFFFFFFFFFFFFFFFFFFFFFFFFFFFFFFFFFFFFFFFFFFFFFFFFFFFFFFFFFFFFFFFFFFFFFFFFFFFFFFFFFFFFFFFFFFFFFFFFFFFFFFFFFFFFFFFFFFFFFFFFFFFFFFFFFFFFFFFFFFFFFFFFFFFFFFFFFFFFFFFFFFFFFFFFFFFFFFFFFFFFFFFFFFFFFFFFFFFFFFFFFFFFFFFFFFFFFFFFFFFFFFFFFFFFFFFFFFFFFFFFFFFFFFFFFFFFFFFFFFFFFFFFFFFFFFFFFFFFFFFFFFFFFFFFFFFFFFFFFFFFFFFFFFFFFFFFFFFFFFFFFFFFFFFFFFFFFFFFFFFFFFFFFFFFFFFFFFFFFFFFFFFFFFFFFFFFFFFFFFFFFFFFFFFFFFFFFFFFFFFFFFFFFFFFFFFFFFFFFFFFFFFFFFFFFFFFFFFFFFFFFFFFFFFFFFFFFFFFFFFFFFFFFFFFFFFFFFFFFFFFFFFFFFFFFFFFFFFFFFFFFFFFFFFFFFFFFFFFFFFFFFFFFFFFFFFFFFFFFFFFFFFFFFFFFFFFFFFFFFFFFFFFFFFFFFFFFFFFFFFFFFFFFFFFFFFFFFFFFFFFFFFFFFFFFFFFFFFFFFFFFFFFFFFFFFFFFFFFFFFFFFFFFFFFFFFFFFFFFFFFFFFFFFFFFFFFFFFFFFFFFFFFFFFFFFFFFFFFFFFFFFFFFFFFFFFFFFFFFFFFFFFFFFFFFFFFFFFFFFFFFFFFFFFFFFFFFFFFFFFFFFFFFFFFFFFFFFFFFFFFFFFFFFFFFFFFFFFFFFFFFFFFFFFFFFFFFFFFFFFFFFFFFFFFFFFFFFFFFFFFFFFFFFFFFFFFFFFFFFFFFFFFFFFFFFFFFFFFFFFFFFFFFFFFFFFFFFFFFFFFFFFFFFFFFFFFFFFFFFFFFFFFFFFFFFFFFFFFFFFFFFFFFFFFFFFFFFFFFFFFFFFFFFFFFFFFFFFFFFFFFFFFFFFFFFFFFFFFFFFFFFFFFFFFFFFFFFFFFFFFFFFFFFFFFFFFFFFFFFFFFFFFFFFFFFFFFFFFFFFFFFFFFFFFFFFFFFFFFFFFFFFFFFFFFFFFFFFFFFFFFFFFFFFFFFFFFFFFFFFFFFFFFFFFFFFFFFFFFFFFFFFFFFFFFFFFFFFFFFFFFFFFFFFFFFFFFFFFFFFFFFFFFFFFFFFFFFFFFFFFFFFFFFFFFFFFFFFFFFFFFFFFFFFFFFFFFFFFFFFFFFFFFFFFFFFFFFFFFFFFFFFFFFFFFFFFFFFFFFFFFFFFFFFFFFFFFFFFFFFFFFFFFFFFFFFFFFFFFFFFFFFFFFFFFFFFFFFFFFFFFFFFFFFFFFFFFFFFFFFFFFFFFFFFFFFFFFFFFFFFFFFFFFFFFFFFFFFFFFFFFFFFFFFFFFFFFFFFFFFFFFFFFFFFFFFFFFFFFFFFFFFFFFFFFFFFFFFFFFFFFFFFFFFFFFFFFFFFFFFFFFFFFFFFF00F000F0


*/

#include <avr/pgmspace.h>

int wr = 4;
int dT = 30; // delay time for write cycles in microseconds



byte data; // general working byte for serially-received data

byte channel;
byte pitch; 
byte velocity;
byte ccnumber; 
byte ccvalue; 

int flag_previous = 0; // keeps track of the previus MIDI byte type received 


// SAMPLES

int SPB_flag = 0;
int SPB_sound = 0;
int SPB_counter = 0;
int SPB_speed = 0;
int SPB_tick = 1;

int SPB_max = 625;
int sampleVolume = 0;



prog_uchar kick[] PROGMEM = {
135, 119, 119, 136, 136, 135, 119, 119, 119, 119, 119, 119,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 136
};

prog_uchar snare[] PROGMEM = {
120, 119, 119, 119, 119, 119, 120, 136, 136, 154, 170, 169,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 119
};

prog_uchar rim[] PROGMEM = {
120, 136, 136, 136, 136, 136, 136, 136, 136, 136, 136, 136,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 136
};

prog_uchar tom[] PROGMEM = {
136, 136, 136, 136, 136, 136, 136, 136, 136, 136, 136, 136,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 152
};

prog_uchar hat_c[] PROGMEM = {
136, 136, 136, 136, 136, 135, 117, 35, 171, 33, 158, 168,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 119  
};

prog_uchar hat_o[] PROGMEM = {
120, 136, 136, 120, 136, 136, 135, 118, 48, 59, 252, 168,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 135
};

prog_uchar ride[] PROGMEM = {
120, 119, 119, 119, 136, 120, 119, 119, 119, 136, 136, 135,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 119
};

prog_uchar crash[] PROGMEM = {
120, 136, 136, 136, 136, 135, 119, 119, 120, 136, 136, 119,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 120
};

prog_uchar pock[] PROGMEM = {
136, 136, 117, 69, 102, 103, 136, 136, 137, 153, 153, 153,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 85
};

prog_uchar toom[] PROGMEM = {
87, 119, 119, 155, 148, 19, 102, 86, 120, 172, 237, 151,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 170
};

prog_uchar dom1[] PROGMEM = {
168, 138, 185, 100, 68, 85, 102, 119, 120, 136, 137, 153,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 153
};

prog_uchar dom2[] PROGMEM = {
152, 138, 167, 51, 85, 86, 119, 120, 136, 137, 153, 153,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 119, 
};

prog_uchar pom[] PROGMEM = {
119, 118, 86, 136, 137, 169, 170, 153, 153, 171, 167, 84,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 136, 
};

prog_uchar ick[] PROGMEM = {
135, 118, 104, 187, 101, 155, 133, 103, 87, 151, 121, 133,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 136
};

prog_uchar zick[] PROGMEM = {
120, 136, 136, 136, 101, 86, 156, 183, 106, 115, 106, 100,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 120
};

prog_uchar zilch[] PROGMEM = {
136, 136, 136, 135, 101, 103, 172, 182, 54, 101, 139, 150,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 103
};

// MEDIUM LENGTH SAMPLES

prog_uchar ekick[] PROGMEM = {
135, 119, 119, 119, 101, 67, 33, 18, 53, 104, 154, 187,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 34
};

prog_uchar esnare[] PROGMEM = {
40, 119, 119, 119, 119, 119, 119, 119, 102, 102, 102, 119,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 136
};

prog_uchar ecow[] PROGMEM = {
119, 119, 119, 119, 119, 119, 119, 102, 102, 103, 120, 154,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 119
};


// LONGER SAMPLES

prog_uchar gtr1[] PROGMEM = {
183, 135, 101, 67, 53, 118, 84, 68, 85, 101, 85, 103,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 203
};

// SPO256-AL2

prog_uchar AA[] PROGMEM = {
  167, 135, 135, 135, 135, 135, 142, 195, 84, 17, 39, 191,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 119
};

prog_uchar AX[] PROGMEM = {
120, 119, 239, 151, 80, 104, 55, 165, 103, 38, 219, 188,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 136
};

prog_uchar DDTWO[] PROGMEM = {
136, 119, 136, 119, 150, 135, 136, 119, 151, 104, 134, 136,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 104
};

prog_uchar EH[] PROGMEM = {
140, 227, 57, 156, 80, 121, 104, 135, 119, 155, 165, 72,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 136
};

prog_uchar NN2[] PROGMEM = {
136, 120, 119, 137, 135, 120, 135, 120, 152, 119, 136, 119,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 119
};

prog_uchar OW[] PROGMEM = {
135, 135, 159, 253, 250, 117, 0, 0, 39, 140, 237, 168,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 135
};

prog_uchar OY[] PROGMEM = {
136, 120, 121, 237, 239, 254, 234, 85, 32, 0, 36, 85,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 135
};

prog_uchar ZZ[] PROGMEM = {
104, 120, 120, 120, 121, 110, 87, 194, 184, 91, 119, 134,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 198
};

// 

prog_uchar piano[] PROGMEM = {
135, 102, 102, 103, 119, 102, 119, 119, 136, 137, 154, 169,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 136
};




/* flag_previous meanings: 
 -1 = note off status
 -2 = note off pitch
 0 = no action / waiting
 1 = note on status
 2 = pitch
 3 = cc status
 4 = cc number
 */


// Setup
void setup() {
  DDRB = B00001111;
  DDRD = B00001111;
  pinMode(wr, OUTPUT);
  digitalWrite(wr, HIGH);
  
  usbMIDI.setHandleControlChange(doCC);
  usbMIDI.setHandleNoteOn(doNote); 
  usbMIDI.setHandleNoteOff(doNoteOff); 
  
  doCC(0, 1, 9);
  doCC(1, 1, 9);
    doCC(1, 1, 9);
  for(int j = 0; j < 8; j++) {
  for(int i = 0; i < 4; i ++) {
    doNote(0, 19 + i + j, 64 + (j * 8));
    doNote(1, 17 + i + j, 64 + (j * 8));
    delay(40);
    doNote(0, 20 + i + j, 0);
    doNote(1, 18 + i + j, 0);
    delay(5);
  }
  

}
  doCC(1, 1, 0);
if(digitalRead(12) == 1) {
  SPB_flag =2;
}

}


// Main Program
void loop() {
  usbMIDI.read(); 
  play_sample();
}


// Functions
void doNote(byte channel, byte pitch, byte velocity) {
    if(channel == 1 && (pitch >= 65 && pitch <= 127) ) {
    SPB_sound = (pitch - 65) % 36;
    
    
    if(SPB_sound < 16) {
    SPB_max = 625;
    }
    
    else if(SPB_sound < 19) {
      
      SPB_max = 1250;
    }
    
    else if(SPB_sound < 20) {
      
      SPB_max = 3000;
    }
    
    else if(SPB_sound < 28) {
      
      SPB_max = 500;
    }
    
    else if(SPB_sound < 29) {
      
      SPB_max = 8000;
    } 
    
    
    
    
    if(velocity > 0) {
      SPB_flag = 1;
      SPB_counter = 0;
    }
    
    else {
      SPB_flag = 0;
    }
  }
  
  
  else if(channel == 0 || channel == 1) {
    pitch = 127 - pitch;
    write2600(B01000000 | (channel << 5) | (pitch % 32)); // write to frequency register
    write2600(B10000000 | (channel << 5) | (velocity / 8)); // write to volume register
  }


}

void doNoteOff(byte channel, byte pitch, byte velocity) {
    if(channel == 1 && (pitch >= 65 && pitch <= 127) ) {
            SPB_flag = 0;
    }

 else if(channel == 0 || channel == 1) {
  write2600(B10000000 | (channel << 5));
}
}

  

void doCC(byte channel, byte ccnumber, byte ccvalue) {
  if(channel == 0 || channel == 1) {
    if(ccnumber == 1) {
      write2600(B00000000 | (channel << 5) | (ccvalue / 8));
    }

    else if(ccnumber == 11) {
      write2600(B10000000 | (channel << 5) | (ccvalue / 16));
    }
    else if(ccnumber == 14 && channel == 1) {
      SPB_speed = ccvalue;
  }
  
}
}


// WRITING DATA TO THE ATARI 2600

void write2600(byte data) {
  PORTB = data >> 4;
  PORTD = data & B00001111;
  digitalWrite(wr, LOW);
  delayMicroseconds(dT);
  digitalWrite(wr, HIGH);
  delayMicroseconds(dT);
}


// PLAY A SAMPLE

void play_sample() {
  if(SPB_flag == 1) {
    
    
    if(SPB_counter >= SPB_max) {
      SPB_flag = 0;
      SPB_counter = 0;
    }
    
    
    if(SPB_tick >= SPB_speed) {
      SPB_tick = 0;
      if(SPB_counter % 2 == 0) {
      switch (SPB_sound) {
        case 0:
        write2600(B10100000 | (B0001111 & pgm_read_byte_near(kick + SPB_counter)));
        break;
      
        case 1:
        write2600(B10100000 | (B0001111 & pgm_read_byte_near(snare + SPB_counter)));
        break;
        
        case 2:
        write2600(B10100000 | (B0001111 & pgm_read_byte_near(rim + SPB_counter)));
        break;
        
        case 3:
        write2600(B10100000 | (B0001111 & pgm_read_byte_near(tom + SPB_counter)));
        break;
        
        case 4:
        write2600(B10100000 | (B0001111 & pgm_read_byte_near(hat_c + SPB_counter)));
        break;
      
        case 5:
        write2600(B10100000 | (B0001111 & pgm_read_byte_near(hat_o + SPB_counter)));
        break;
        
        case 6:
        write2600(B10100000 | (B0001111 & pgm_read_byte_near(ride + SPB_counter)));
        break;
        
        case 7:
        write2600(B10100000 | (B0001111 & pgm_read_byte_near(crash + SPB_counter)));
        break; 
        
        case 8:
        write2600(B10100000 | (B0001111 & pgm_read_byte_near(pock + SPB_counter)));
        break;
      
        case 9:
        write2600(B10100000 | (B0001111 & pgm_read_byte_near(toom + SPB_counter)));
        break;
        
        case 10:
        write2600(B10100000 | (B0001111 & pgm_read_byte_near(dom1 + SPB_counter)));
        break;
        
        case 11:
        write2600(B10100000 | (B0001111 & pgm_read_byte_near(dom2 + SPB_counter)));
        break;
        
        case 12:
        write2600(B10100000 | (B0001111 & pgm_read_byte_near(pom + SPB_counter)));
        break;
      
        case 13:
        write2600(B10100000 | (B0001111 & pgm_read_byte_near(ick + SPB_counter)));
        break;
        
        case 14:
        write2600(B10100000 | (B0001111 & pgm_read_byte_near(zick + SPB_counter)));
        break;
        
        case 15:
        write2600(B10100000 | (B0001111 & pgm_read_byte_near(zilch + SPB_counter)));
        break;
        
        case 16:
        write2600(B10100000 | (B0001111 & pgm_read_byte_near(ekick + SPB_counter)));
        break;
        
        case 17:
        write2600(B10100000 | (B0001111 & pgm_read_byte_near(esnare + SPB_counter)));
        break;
        
        case 18:
        write2600(B10100000 | (B0001111 & pgm_read_byte_near(ecow + SPB_counter)));
        break;
        
        case 19:
        write2600(B10100000 | (B0001111 & pgm_read_byte_near(gtr1 + SPB_counter)));
        break;
        
        
        
        
        
        case 20:
        write2600(B10100000 | (B0001111 & pgm_read_byte_near(AA + SPB_counter)));
        break;
        
        case 21:
        write2600(B10100000 | (B0001111 & pgm_read_byte_near(AX + SPB_counter)));
        break;
        
        case 22:
        write2600(B10100000 | (B0001111 & pgm_read_byte_near(DDTWO + SPB_counter)));
        break;
        
        case 23:
        write2600(B10100000 | (B0001111 & pgm_read_byte_near(EH + SPB_counter)));
        break;
        
        case 24:
        write2600(B10100000 | (B0001111 & pgm_read_byte_near(NN2 + SPB_counter)));
        break;
        
        case 25:
        write2600(B10100000 | (B0001111 & pgm_read_byte_near(OW + SPB_counter)));
        break;
        
        case 26:
        write2600(B10100000 | (B0001111 & pgm_read_byte_near(OY + SPB_counter)));
        break;
        
        case 27:
        write2600(B10100000 | (B0001111 & pgm_read_byte_near(ZZ + SPB_counter)));
        break;
        
        case 28:
        write2600(B10100000 | (B0001111 & pgm_read_byte_near(piano + SPB_counter)));
        break;
        
        

          
      }
      }
      
    else {
      switch (SPB_sound) {
        case 0:
        write2600(B10100000 | (B0001111 & (pgm_read_byte_near(kick + SPB_counter) >> 4)));
        break;
      
        case 1:
        write2600(B10100000 | (B0001111 & (pgm_read_byte_near(snare + SPB_counter) >> 4)));
        break;
        
        case 2:
        write2600(B10100000 | (B0001111 & (pgm_read_byte_near(rim + SPB_counter) >> 4)));
        break;
        
        case 3:
        write2600(B10100000 | (B0001111 & (pgm_read_byte_near(tom + SPB_counter) >> 4)));
        break;
        
        case 4:
        write2600(B10100000 | (B0001111 & (pgm_read_byte_near(hat_c + SPB_counter) >> 4)));
        break;
      
        case 5:
        write2600(B10100000 | (B0001111 & (pgm_read_byte_near(hat_o + SPB_counter) >> 4)));
        break;
        
        case 6:
        write2600(B10100000 | (B0001111 & (pgm_read_byte_near(ride + SPB_counter) >> 4)));
        break;
        
        case 7:
        write2600(B10100000 | (B0001111 & (pgm_read_byte_near(crash + SPB_counter) >> 4)));
        break; 
        
        case 8:
        write2600(B10100000 | (B0001111 & (pgm_read_byte_near(pock + SPB_counter) >> 4)));
        break;
      
        case 9:
        write2600(B10100000 | (B0001111 & (pgm_read_byte_near(toom + SPB_counter) >> 4)));
        break;
        
        case 10:
        write2600(B10100000 | (B0001111 & (pgm_read_byte_near(dom1 + SPB_counter) >> 4)));
        break;
        
        case 11:
        write2600(B10100000 | (B0001111 & (pgm_read_byte_near(dom2 + SPB_counter) >> 4)));
        break;
        
        case 12:
        write2600(B10100000 | (B0001111 & (pgm_read_byte_near(pom + SPB_counter) >> 4)));
        break;
      
        case 13:
        write2600(B10100000 | (B0001111 & (pgm_read_byte_near(ick + SPB_counter) >> 4)));
        break;
        
        case 14:
        write2600(B10100000 | (B0001111 & (pgm_read_byte_near(zick + SPB_counter) >> 4)));
        break;
        
        case 15:
        write2600(B10100000 | (B0001111 & (pgm_read_byte_near(zilch + SPB_counter) >> 4)));
        break;
        
        case 16:
        write2600(B10100000 | (B0001111 & (pgm_read_byte_near(ekick + SPB_counter) >> 4)));
        break;
        
        case 17:
        write2600(B10100000 | (B0001111 & (pgm_read_byte_near(esnare + SPB_counter) >> 4)));
        break;
        
        case 18:
        write2600(B10100000 | (B0001111 & (pgm_read_byte_near(ecow + SPB_counter) >> 4)));
        break;
        
        case 19:
        write2600(B10100000 | (B0001111 & (pgm_read_byte_near(gtr1 + SPB_counter) >> 4)));
        break;
        
         case 20:
        write2600(B10100000 | (B0001111 & (pgm_read_byte_near(AA + SPB_counter) >> 4)));
        break;
        
         case 21:
        write2600(B10100000 | (B0001111 & (pgm_read_byte_near(AX + SPB_counter) >> 4)));
        break;
        
         case 22:
        write2600(B10100000 | (B0001111 & (pgm_read_byte_near(DDTWO + SPB_counter) >> 4)));
        break;
        
         case 23:
        write2600(B10100000 | (B0001111 & (pgm_read_byte_near(EH + SPB_counter) >> 4)));
        break;
        
         case 24:
        write2600(B10100000 | (B0001111 & (pgm_read_byte_near(NN2 + SPB_counter) >> 4)));
        break;
        
         case 25:
        write2600(B10100000 | (B0001111 & (pgm_read_byte_near(OW + SPB_counter) >> 4)));
        break;
        
         case 26:
        write2600(B10100000 | (B0001111 & (pgm_read_byte_near(OY + SPB_counter) >> 4)));
        break;
        
         case 27:
        write2600(B10100000 | (B0001111 & (pgm_read_byte_near(ZZ + SPB_counter) >> 4)));
        break;
        
        case 28:
        write2600(B10100000 | (B0001111 & (pgm_read_byte_near(piano + SPB_counter) >> 4)));
        break;
        
        
          
      }
    }
      
      
      SPB_counter = SPB_counter + 1;
      SPB_tick = 0; 
    }
    
    if(SPB_tick < SPB_speed) {
      SPB_tick = SPB_tick + 1;
    }

  }

}

